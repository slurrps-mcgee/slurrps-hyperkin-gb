## buildroot/package/retronsq/Config.in
```kconfig
config BR2_PACKAGE_RETRONSQ
	bool "retronsq"
	depends on BR2_TOOLCHAIN_HAS_THREADS
	select BR2_PACKAGE_SDL2
	select BR2_PACKAGE_SDL2_IMAGE
	select BR2_PACKAGE_SDL2_TTF
	select BR2_PACKAGE_DEJAVU
	select BR2_PACKAGE_DEJAVU_SANS
	help
	  The Retron SQ custom firmware's own software: the cartridge
	  library and tools (libsqcart, sqcart, sqload, Cartridge Tools),
	  the session that runs games, cartridge hot-plug handling, the
	  boot script and the boot/loading screens.
```

## buildroot/package/rockchip/partinit/Config.in
```kconfig
config BR2_PACKAGE_PARTINIT
	bool "script for partition init"
	help
	  script for partition init: S21mountall.sh (grow, check and mount the
	  partitions), the fstab and the /dev/block/by-name udev rules.

	  (Stock Rockchip made this depend on usbmount, which the Retron SQ
	  firmware doesn't use; with that dependency, removing usbmount
	  silently dropped this package.)
```
